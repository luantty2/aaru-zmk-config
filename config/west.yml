## config/west.yml
```yaml
manifest:
  remotes:
    - name: zmk
      url-base: https://github.com/luantty2/zmk
  projects:
    - name: zmk
      remote: luantty2
      revision: aaru-max17048-indicator
      import: app/west.yml
  self:
    path: config
```
